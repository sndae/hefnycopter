/*
 * LCD.cpp
 *
 * Created: 8/13/2012 8:38:43 PM
 *  Author: hefny
 */ 

#include <stdlib.h>
#include <string.h>
#include <avr/io.h> 
#include <math.h>
#include <avr/delay.h>
#include <avr/pgmspace.h>
 
#include "../include/IO_config.h"
#include "../include/LCD_ST7565.h"
#include "../Include/Misc.h"
#include "../Include/Fonts.h"



#define ST7565_STARTBYTES 1

uint8_t is_reversed = 1;

// a handy reference to where the pages are on the screen
//const uint8_t pagemap[] = { 3, 2, 1, 0, 7, 6, 5, 4 };
//  const uint8_t pagemap[] = { 7, 6, 5, 4, 3, 2, 1, 0 };
//	  const uint8_t pagemap[] = { 0,3,2,1,4,7,6,5 };
 const uint8_t pagemap[] = { 7, 6, 5, 4, 3, 2, 1, 0 };
// a 5x7 font table
extern uint8_t PROGMEM font[];
static uint8_t _curx, _cury;
static fontdescriptor_t _font;


// the memory buffer for the LCD
uint8_t st7565_buffer[1024] = { 
0x0, 0x0, 0x0, 0x0, 0x0, 0x0, 0x0, 0x0, 0x0, 0x0, 0x0, 0x0, 0x0, 0x0, 0x0, 0x0, 
0x0, 0x0, 0x0, 0x0, 0x0, 0x0, 0x0, 0x0, 0x0, 0x0, 0x0, 0x0, 0x0, 0x0, 0x0, 0x0, 
0x0, 0x0, 0x0, 0x0, 0x0, 0x0, 0x0, 0x0, 0x0, 0x0, 0x0, 0x0, 0x0, 0x0, 0x0, 0x0, 
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0x0, 0x0, 0x0, 0x0, 0x0, 0x0, 0x0, 0x0, 0x0, 0x0, 0x0, 0x0, 0x0, 0x0, 0x0, 0x0,};
  
 
 
// reduces how much is refreshed, which speeds it up!
// originally derived from Steve Evans/JCW's mod but cleaned up and
// optimized
//#define enablePartialUpdate

#ifdef enablePartialUpdate
static uint8_t xUpdateMin, xUpdateMax, yUpdateMin, yUpdateMax;
#endif

static const prog_uchar _initSeq[] = {
CMD_DISPLAY_ON,
CMD_SET_DISP_START_LINE,
CMD_SET_ADC_NORMAL,
CMD_SET_DISP_NORMAL,
CMD_SET_ALLPTS_NORMAL,
0xa2,
0xee,
CMD_SET_COM_NORMAL,
0x2f,	//power control	Vreg int res ratio
0x24,
0xac,	//static off
CMD_NOP,
0xff,
0x00 // Termination
};	

void LCD_ST7565::Init()
{
	 
  // LCD
  LCD_CS1_DIR  = OUTPUT;
  LCD_RES_DIR  = OUTPUT;
  LCD_A0_DIR   = OUTPUT;
  LCD_SClK_DIR = OUTPUT;
  LCD_SI_DIR   = OUTPUT;
	
  LCD_CS1 = HIGH;
  LCD_SClK = HIGH;
  LCD_RES = LOW;
  _delay_us(500);
  LCD_RES = HIGH;
 /*
	st7565_Command(CMD_DISPLAY_ON); //LCD ON		Display start line set
	st7565_Command(CMD_SET_DISP_START_LINE);

	st7565_Command(CMD_SET_ADC_NORMAL); //ADC		nor/res
	st7565_Command(CMD_SET_DISP_NORMAL);

	st7565_Command(CMD_SET_ALLPTS_NORMAL); // disp normal	bias 1/9
	st7565_Command(0xa2);

	st7565_Command(0xee); // end		COM
	st7565_Command(CMD_SET_COM_NORMAL);

	st7565_Command(0x2f); //;power control	Vreg int res ratio
	st7565_Command(0x24);

	st7565_Command(0xac); //;static off
	
	st7565_Command(CMD_NOP); // NOP
	st7565_Command(0xff);
*/
 
	const unsigned char* ptr = _initSeq;
	uint8_t c;
	while ((c = *ptr))
	{
		ptr+=1;
		st7565_Command(c);
	}		
	
	
}




static void updateBoundingBox(uint8_t xmin, uint8_t ymin, uint8_t xmax, uint8_t ymax) {
#ifdef enablePartialUpdate
  if (xmin < xUpdateMin) xUpdateMin = xmin;
  if (xmax > xUpdateMax) xUpdateMax = xmax;
  if (ymin < yUpdateMin) yUpdateMin = ymin;
  if (ymax > yUpdateMax) yUpdateMax = ymax;
#endif
}

void LCD_ST7565::DrawBitmap(uint8_t x, uint8_t y, 
			const uint8_t *bitmap, uint8_t w, uint8_t h,
			uint8_t color) {
  for (uint8_t j=0; j<h; j++) {
    for (uint8_t i=0; i<w; i++ ) {
      if (pgm_read_byte(bitmap + i + (j/8)*w) & _BV(j%8)) {
	my_setpixel(x+i, y+j, color);
      }
    }
  }

  updateBoundingBox(x, y, x+w, y+h);
}

void LCD_ST7565::DrawString(uint8_t x, uint8_t line, char *c) {
  while (c[0] != 0) {
    DrawChar(x, line, c[0]);
    c++;
    x += 6; // 6 pixels wide
    if (x + 6 >= LCDWIDTH) {
      x = 0;    // ran out of this line
      line++;
    }
    if (line >= (LCDHEIGHT/8))
      return;        // ran out of space :(
  }
}


void LCD_ST7565::DrawString_P(uint8_t x, uint8_t line, const char *str) {
  while (1) {
    char c = pgm_read_byte(str++);
    if (! c)
      return;
    DrawChar(x, line, c);
    x += 6; // 6 pixels wide
    if (x + 6 >= LCDWIDTH) {
      x = 0;    // ran out of this line
      line++;
    }
    if (line >= (LCDHEIGHT/8))
      return;        // ran out of space :(
  }
}




void LCD_ST7565::LCDdWriteSprite_P(PGM_P sprite, uint8_t sizeX, uint8_t sizeY, uint8_t mode)
{
	uint8_t b = 0;
	for (uint8_t i = 0; i < sizeX; i++)
	{
		for (uint8_t j = 0; j < sizeY; j++)
		{
			if (j % 8 == 0)
					b = pgm_read_byte(sprite++);
					
			//if (mode == ROP_COPY)
			//{
				if ((_cury % 8 == 0) && (sizeY - j >= 8))
				{
					st7565_buffer[_curx + i, + (_cury + j*128) ] =b; //lcdSetByte(_curx + i, _cury + j, b);
					j += 7; // just +7 b/c the loop increments anyway
				}
				else
					//lcdSetPixel(_curx + i, _cury + j, b & 0x01);
			//}				
			//else if (mode == ROP_PAINT)
			//{
				//if (b & 0x01)
					//lcdSetPixel(_curx + i, _cury + j, 1);
			//}			
			b >>= 1;
		}
	}	
}

void  LCD_ST7565::DrawChar(uint8_t x, uint8_t line, char c) {
	
/*  for (uint8_t i =0; i<5; i++ ) {
    st7565_buffer[x + (line*128) ] = pgm_read_byte(font +(c*5)+i);
    x++;
  }

  updateBoundingBox(x, line*8, x+5, line*8 + 8);
  */

	if (c == '\n')
	{
		_cury += _font.sizeY;
		_curx = 0;
	}
	else
	{
		LCDdWriteSprite_P(_font.selector(c), _font.sizeX, _font.sizeY, 0);
		_curx += _font.sizeX;
	}
}




// bresenham's algorithm - thx wikpedia
void LCD_ST7565::DrawLine(uint8_t x0, uint8_t y0, uint8_t x1, uint8_t y1, uint8_t color) {
  uint8_t steep = abs(y1 - y0) > abs(x1 - x0);
  if (steep) {
    uint8_tswap(x0, y0);
    uint8_tswap(x1, y1);
  }

  if (x0 > x1) {
    uint8_tswap(x0, x1);
    uint8_tswap(y0, y1);
  }

  // much faster to put the test here, since we've already sorted the points
  updateBoundingBox(x0, y0, x1, y1);

  uint8_t dx, dy;
  dx = x1 - x0;
  dy = abs(y1 - y0);

  int8_t err = dx / 2;
  int8_t ystep;

  if (y0 < y1) {
    ystep = 1;
  } else {
    ystep = -1;}

  for (; x0<=x1; x0++) {
    if (steep) {
      my_setpixel(y0, x0, color);
    } else {
      my_setpixel(x0, y0, color);
    }
    err -= dy;
    if (err < 0) {
      y0 += ystep;
      err += dx;
    }
  }
}

// filled rectangle
void LCD_ST7565::FillRect(uint8_t x, uint8_t y, uint8_t w, uint8_t h, 
		      uint8_t color) {

  // stupidest version - just pixels - but fast with internal buffer!
  for (uint8_t i=x; i<x+w; i++) {
    for (uint8_t j=y; j<y+h; j++) {
      my_setpixel(i, j, color);
    }
  }

  updateBoundingBox(x, y, x+w, y+h);
}

// draw a rectangle
void LCD_ST7565::DrawRect(uint8_t x, uint8_t y, uint8_t w, uint8_t h, 
		      uint8_t color) {
  // stupidest version - just pixels - but fast with internal buffer!
  for (uint8_t i=x; i<x+w; i++) {
    my_setpixel(i, y, color);
    my_setpixel(i, y+h-1, color);
  }
  for (uint8_t i=y; i<y+h; i++) {
    my_setpixel(x, i, color);
    my_setpixel(x+w-1, i, color);
  } 

  updateBoundingBox(x, y, x+w, y+h);
}

// draw a circle outline
void LCD_ST7565::DrawCircle(uint8_t x0, uint8_t y0, uint8_t r, uint8_t color) {
  updateBoundingBox(x0-r, y0-r, x0+r, y0+r);

  int8_t f = 1 - r;
  int8_t ddF_x = 1;
  int8_t ddF_y = -2 * r;
  int8_t x = 0;
  int8_t y = r;

  my_setpixel(x0, y0+r, color);
  my_setpixel(x0, y0-r, color);
  my_setpixel(x0+r, y0, color);
  my_setpixel(x0-r, y0, color);

  while (x<y) {
    if (f >= 0) {
      y--;
      ddF_y += 2;
      f += ddF_y;
    }
    x++;
    ddF_x += 2;
    f += ddF_x;
  
    my_setpixel(x0 + x, y0 + y, color);
    my_setpixel(x0 - x, y0 + y, color);
    my_setpixel(x0 + x, y0 - y, color);
    my_setpixel(x0 - x, y0 - y, color);
    
    my_setpixel(x0 + y, y0 + x, color);
    my_setpixel(x0 - y, y0 + x, color);
    my_setpixel(x0 + y, y0 - x, color);
    my_setpixel(x0 - y, y0 - x, color);
    
  }



}

void LCD_ST7565::FillCircle(uint8_t x0, uint8_t y0, uint8_t r, 
			uint8_t color) {
  updateBoundingBox(x0-r, y0-r, x0+r, y0+r);

  int8_t f = 1 - r;
  int8_t ddF_x = 1;
  int8_t ddF_y = -2 * r;
  int8_t x = 0;
  int8_t y = r;

  for (uint8_t i=y0-r; i<=y0+r; i++) {
    my_setpixel(x0, i, color);
  }

  while (x<y) {
    if (f >= 0) {
      y--;
      ddF_y += 2;
      f += ddF_y;
    }
    x++;
    ddF_x += 2;
    f += ddF_x;
  
    for (uint8_t i=y0-y; i<=y0+y; i++) {
      my_setpixel(x0+x, i, color);
      my_setpixel(x0-x, i, color);
    } 
    for (uint8_t i=y0-x; i<=y0+x; i++) {
      my_setpixel(x0+y, i, color);
      my_setpixel(x0-y, i, color);
    }    
  }
}

void LCD_ST7565::my_setpixel(uint8_t x, uint8_t y, uint8_t color) {
  if ((x >= LCDWIDTH) || (y >= LCDHEIGHT))
    return;

  // x is which column
  if (color) 
    st7565_buffer[x+ (y/8)*128] |= _BV(7-(y%8));  
  else
    st7565_buffer[x+ (y/8)*128] &= ~_BV(7-(y%8)); 
}

// the most basic function, set a single pixel
void LCD_ST7565::SetPixel(uint8_t x, uint8_t y, uint8_t color) {
  if ((x >= LCDWIDTH) || (y >= LCDHEIGHT))
    return;

  // x is which column
  if (color) 
    st7565_buffer[x+ (y/8)*128] |= _BV(7-(y%8));  
  else
    st7565_buffer[x+ (y/8)*128] &= ~_BV(7-(y%8)); 

  updateBoundingBox(x,y,x,y);
}


// the most basic function, get a single pixel
uint8_t LCD_ST7565::GetPixel(uint8_t x, uint8_t y) {
  if ((x >= LCDWIDTH) || (y >= LCDHEIGHT))
    return 0;

  return (st7565_buffer[x+ (y/8)*128] >> (7-(y%8))) & 0x1;  
}

 
void LCD_ST7565::Display(void) {
  uint8_t col, maxcol, p;

 
  for(p = 0; p < 8; p++) {
 
#ifdef enablePartialUpdate
    // check if this page is part of update
    if ( yUpdateMin >= ((p+1)*8) ) {
      continue;   // nope, skip it!
    }
    if (yUpdateMax < p*8) {
      break;
    }
#endif

    st7565_Command(CMD_SET_PAGE | pagemap[p]);
	

#ifdef enablePartialUpdate
    col = xUpdateMin;
    maxcol = xUpdateMax;
#else
    // start at the beginning of the row
    col = 0;
    maxcol = LCDWIDTH;
#endif

    st7565_Command(CMD_SET_COLUMN_LOWER | ((col+ST7565_STARTBYTES) & 0xf));
    st7565_Command(CMD_SET_COLUMN_UPPER | (((col+ST7565_STARTBYTES) >> 4) & 0xf));
    st7565_Command(CMD_RMW);
    
    for(; col < maxcol; col++) {
      st7565_Data(st7565_buffer[(128*p)+col]);
    }
  }

#ifdef enablePartialUpdate
  xUpdateMin = LCDWIDTH - 1;
  xUpdateMax = 0;
  yUpdateMin = LCDHEIGHT-1;
  yUpdateMax = 0;
#endif
}



// clear everything
void LCD_ST7565::Clear(void) {
  memset(st7565_buffer, 0, 1024);
  updateBoundingBox(0, 0, LCDWIDTH-1, LCDHEIGHT-1);
}


// this doesnt touch the buffer, just clears the display RAM - might be handy
void LCD_ST7565::ClearDisplay(void) {
  uint8_t p, c;
  
  for(p = 0; p < 8; p++) {
    st7565_Command(CMD_SET_PAGE | p);
    for(c = 0; c < 129; c++) {
      st7565_Command(CMD_SET_COLUMN_LOWER | (c & 0xf));
      st7565_Command(CMD_SET_COLUMN_UPPER | ((c >> 4) & 0xf));
      st7565_Data(0x0);
    }     
  }
}



void LCD_ST7565::Set_Brightness(uint8_t val) {
    st7565_Command(CMD_SET_VOLUME_FIRST);
    st7565_Command(CMD_SET_VOLUME_SECOND | (val & 0x3f));
}



void LCD_ST7565::st7565_Command(uint8_t c) {
  LCD_A0 = LOW;
  LCD_CS1 = LOW;	
  ShiftOut(c);
  LCD_CS1 = HIGH;

  
}

void LCD_ST7565::st7565_Data(uint8_t c) {
  LCD_A0 = HIGH;
  LCD_CS1 = LOW;	
  ShiftOut(c);
  LCD_CS1 = HIGH;

}



void LCD_ST7565::ShiftOut(uint8_t datain)
{ 
	unsigned char i;
	
	for(i=8;i>0;i--)
	{
		LCD_SClK=0;
	
		if(datain & 0x80)
		{
			LCD_SI=1;
		}
		else 
		{
			LCD_SI=0;
		}
		LCD_SClK=1;
		datain = datain << 1; 
	}
}

